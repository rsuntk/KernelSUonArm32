## kernel/Kconfig
```kconfig
menu "KernelSU"

config KSU
	bool "KernelSU function support"
	default y
	help
	  Enable kernel-level root privileges on Android System.

config KSU_DEBUG
	bool "KernelSU debug mode"
	depends on KSU
	default n
	help
	  Enable KernelSU debug mode.

config KSU_ALLOWLIST_WORKAROUND
    bool "KernelSU Session init keyring workaround"
    depends on KSU
    default n
    help
      Enable session keyring init workaround for problematic devices.
      Useful for situations where the SU allowlist is not kept after a reboot.

config KSU_CMDLINE
	bool "Enable KernelSU cmdline"
	depends on KSU
	default n
	help
	  Enable a cmdline called kernelsu.enabled
	  Value 1 means enabled, value 0 means disabled.
	  affected.

endmenu
```
